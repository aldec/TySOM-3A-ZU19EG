## Yocto_Project/2018.3/TySOM-3A-ZU19EG/src/meta-aldec/conf/layer.conf
```bitbake
# We have a conf and classes directory, add to BBPATH
BBPATH .= ":${LAYERDIR}"

# We have a packages directory, add to BBFILES
BBFILES += "${LAYERDIR}/recipes-*/*/*.bb"
BBFILES += "${LAYERDIR}/recipes-*/*/*.bbappend"

BBFILE_COLLECTIONS += "aldec"
BBFILE_PATTERN_aldec = "^${LAYERDIR}/"
BBFILE_PRIORITY_aldec = "5"

LAYERDEPENDS_aldec = "core"
LAYERDEPENDS_aldec = "xilinx"
```

## Yocto_Project/2018.3/TySOM-3A-ZU19EG/src/meta-aldec/conf/machine/tysom-3-zu7ev.conf
```bitbake
#@TYPE: Machine
#@NAME: TySOM-3-ZU7EV
#@DESCRIPTION: Machine support for TySOM-3-ZU7EV Evaluation Board.
#
# For details on the Evaluation board:
#     https://www.aldec.com/en/products/emulation/tysom_boards
#

SOC_VARIANT ?= "ev"
DISTRO_FEATURES_append = " x11"

require conf/machine/include/tune-zynqmp.inc
require conf/machine/include/machine-xilinx-overrides.inc
require conf/machine/include/machine-xilinx-default.inc
require conf/machine/include/machine-xilinx-board.inc
include conf/machine/include/zynqmp-pmu-config.inc


MACHINE_FEATURES = "rtc ext2 ext3 vfat usbhost qemu-system-xilinx"

# u-boot configuration
UBOOT_MACHINE = "zynqmp_tysom_3_defconfig"

SERIAL_CONSOLE = "115200 ttyPS0"

PREFERRED_PROVIDER_virtual/kernel ?= "linux-xlnx"
PREFERRED_PROVIDER_virtual/bootloader ?= "u-boot-xlnx"
PREFERRED_PROVIDER_virtual/pmu-firmware ?= "zynqmp-pmu-pmu-firmware"

EXTRA_IMAGEDEPENDS += " \
                u-boot-zynq-uenv \
                arm-trusted-firmware \
                "

# Options for system with HDMI/DP output
# Add file to all image 
#IMAGE_INSTALL_append = " libdrm-tests \
#                         coreutils \
#                         aldec-utils \
#                         libgles1 \
#                         firefox \
#                         "
#

# Add file only to core-image-minimal-xfce
IMAGE_INSTALL_append_pn-core-image-minimal-xfce = " libdrm-tests \
                         coreutils \
                         aldec-utils \
                         libgles1 \
                         firefox \
                         "

# Out of tree HDMI modules
MACHINE_ESSENTIAL_EXTRA_RDEPENDS += "kernel-module-hdmi"
```

## Yocto_Project/2020.2/TySOM-3A-ZU19EG/meta-aldec/conf/layer.conf
```bitbake
# We have a conf and classes directory, add to BBPATH
BBPATH .= ":${LAYERDIR}"

# We have a packages directory, add to BBFILES
BBFILES += "${LAYERDIR}/recipes-*/*/*.bb"
BBFILES += "${LAYERDIR}/recipes-*/*/*.bbappend"

BBFILE_COLLECTIONS += "aldec"
BBFILE_PATTERN_aldec = "^${LAYERDIR}/"
BBFILE_PRIORITY_aldec = "5"

LAYERDEPENDS_aldec = "core"
LAYERDEPENDS_aldec = "xilinx"

LAYERSERIES_COMPAT_aldec = "zeus"

BB_DANGLINGAPPENDS_WARNONLY ?= "1"

XILINX_RELEASE_VERSION = "v2020.2"

#BBMASK = "external-hdf"
```

## Yocto_Project/2020.2/TySOM-3A-ZU19EG/meta-aldec/conf/machine/tysom-3a-zu19eg.conf
```bitbake
#@TYPE: Machine
#@NAME: TySOM-3A-ZU19EG
#@DESCRIPTION: Machine support for TySOM-3A-ZU19EG Evaluation Board.
#
# For details on the Evaluation board:
#     https://www.aldec.com/en/products/emulation/tysom_boards
#

SOC_VARIANT = "eg"

UBOOT_MACHINE = "zynqmp_tysom_3a_defconfig"
SPL_BINARY ?= "spl/boot.bin"

require conf/machine/include/soc-zynqmp.inc
require conf/machine/include/machine-xilinx-default.inc
require conf/machine/include/machine-xilinx-qemu.inc

MACHINE_FEATURES = "rtc ext2 ext3 vfat usbhost"

# Default SD image build onfiguration, use qemu-sd to pad
#IMAGE_CLASSES += "image-types-xilinx-qemu"
#IMAGE_FSTYPES += "wic.qemu-sd"
#WKS_FILES ?= "sdimage-bootpart.wks"

SERIAL_CONSOLES ?= "115200;ttyPS0"

EXTRA_IMAGEDEPENDS += " \
 		u-boot-zynq-uenv \
		arm-trusted-firmware \
		qemu-devicetrees \
		virtual/boot-bin \
		virtual/bootloader \
		u-boot-zynq-scr \
		firmware \
		kernel-module-hdmi \
		kernel-module-mali \
		"

CORE_IMAGE_EXTRA_INSTALL += " firmware kernel-module-hdmi kernel-module-mali iw "

IMAGE_BOOT_FILES += " \
	uEnv.txt \
	atf-uboot.ub \
	${@bb.utils.contains('PREFERRED_PROVIDER_virtual/dtb', 'device-tree', 'system.dtb', '', d)} \
	boot.scr \
	"

YAML_SERIAL_CONSOLE_STDIN = "psu_uart_1"
YAML_SERIAL_CONSOLE_STDOUT = "psu_uart_1"
```
