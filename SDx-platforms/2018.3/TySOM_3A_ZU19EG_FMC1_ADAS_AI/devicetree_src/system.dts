/*
 * CAUTION: This file is automatically generated by Xilinx.
 * Version:  
 * Today is: Thu Oct 25 11:07:18 2018
 */


&gem1 {
	local-mac-address = [00 0a 35 00 00 00];
};
&gem2 {
	local-mac-address = [00 0a 35 00 00 01];
};
